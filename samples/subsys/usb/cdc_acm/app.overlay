/*
 * Copyright (c) 2021 Nordic Semiconductor ASA
 *
 * SPDX-License-Identifier: Apache-2.0
 */

&zephyr_udc0 {
	cdc_acm_uart0 {
		status = "okay";
		tx-fifo-size = <256>;
		rx-fifo-size = <256>;
		compatible = "zephyr,cdc-acm-uart";
	};

	cdc_acm_uart1 {
		status = "okay";
		tx-fifo-size = <256>;
		rx-fifo-size = <256>;
		compatible = "zephyr,cdc-acm-uart";
	};
};
