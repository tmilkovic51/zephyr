## CMakeLists.txt
```
# SPDX-License-Identifier: Apache-2.0

cmake_minimum_required(VERSION 3.20.0)

find_package(Zephyr REQUIRED HINTS $ENV{ZEPHYR_BASE})
project(lvgl)

FILE(GLOB app_sources src/*.c)
target_sources(app PRIVATE ${app_sources} ../../../../../modules/lib/gui/lvgl/demos/widgets/lv_demo_widgets.c ../../../../../modules/lib/gui/lvgl/demos/widgets/assets/img_clothes.c ../../../../../modules/lib/gui/lvgl/demos/widgets/assets/img_lvgl_logo.c ../../../../../modules/lib/gui/lvgl/demos/widgets/assets/img_demo_widgets_avatar.c)
```

## prj.conf
```kconfig
CONFIG_LV_Z_MEM_POOL_NUMBER_BLOCKS=8
CONFIG_MAIN_STACK_SIZE=2048

CONFIG_DISPLAY=y
CONFIG_DISPLAY_LOG_LEVEL_ERR=y

CONFIG_LOG=y

CONFIG_LVGL=y
CONFIG_LV_MEM_CUSTOM=y
CONFIG_LV_USE_LOG=y
CONFIG_LV_USE_LABEL=y
CONFIG_LV_USE_BTN=y
CONFIG_LV_USE_IMG=y
CONFIG_LV_FONT_MONTSERRAT_12=y
CONFIG_LV_FONT_MONTSERRAT_14=y
CONFIG_LV_FONT_MONTSERRAT_16=y
CONFIG_LV_FONT_MONTSERRAT_18=y
CONFIG_LV_FONT_MONTSERRAT_20=y
CONFIG_LV_FONT_MONTSERRAT_22=y
CONFIG_LV_FONT_MONTSERRAT_24=y
CONFIG_LV_USE_DEMO_WIDGETS=y
CONFIG_LV_DEMO_WIDGETS_SLIDESHOW=y
CONFIG_LV_THEME_DEFAULT_DARK=y

# extra memory needed for storage of LVGL's GUI elements
CONFIG_MAIN_STACK_SIZE=8192
CONFIG_LV_Z_MEM_POOL_MAX_SIZE=55000
CONFIG_LV_Z_MEM_POOL_NUMBER_BLOCKS=4
```

## boards/native_posix.conf
```kconfig
CONFIG_KSCAN=y
CONFIG_SDL_POINTER_KSCAN_DEV_NAME="KSCAN"
CONFIG_LV_Z_POINTER_KSCAN=y
CONFIG_LV_Z_POINTER_KSCAN_MSGQ_COUNT=2
CONFIG_LV_USE_LOG=n
CONFIG_LOG_MAX_LEVEL=0
```

## boards/native_posix_64.conf
```kconfig
CONFIG_KSCAN=y
```

## boards/stm32f746g_disco.conf
```kconfig
CONFIG_LV_Z_POINTER_KSCAN=y
CONFIG_LV_Z_POINTER_KSCAN_DEV_NAME="FT5336"
CONFIG_LV_COLOR_DEPTH_16=y
CONFIG_LV_Z_BITS_PER_PIXEL=16
CONFIG_LV_Z_VDB_SIZE=5
```

## boards/native_posix_64.overlay
```dts
/*
 * Copyright (c) 2019 Jan Van Winkel (jan.van_winkel@dxplore.eu)
 *
 * SPDX-License-Identifier: Apache-2.0
 */

&sdl_dc {
	height = <720>;
	width = <1280>;
};
```

## src/main.c
```c
/*
 * Copyright (c) 2018 Jan Van Winkel <jan.van_winkel@dxplore.eu>
 *
 * SPDX-License-Identifier: Apache-2.0
 */

#include <zephyr/device.h>
#include <zephyr/drivers/display.h>
#include <lvgl.h>
#include <stdio.h>
#include <string.h>
#include <zephyr/zephyr.h>
#include <../../../../../modules/lib/gui/lvgl/demos/lv_demos.h>

#define LOG_LEVEL CONFIG_LOG_DEFAULT_LEVEL
#include <zephyr/logging/log.h>
LOG_MODULE_REGISTER(app);

void main(void)
{
	const struct device *display_dev;

	display_dev = DEVICE_DT_GET(DT_CHOSEN(zephyr_display));
	if (!device_is_ready(display_dev)) {
		LOG_ERR("Device not ready, aborting test");
		return;
	}

	lv_demo_widgets();

	lv_task_handler();
	display_blanking_off(display_dev);

	while (1) {
		lv_task_handler();
		k_sleep(K_MSEC(10));
	}
}
```
