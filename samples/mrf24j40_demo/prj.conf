## CMakeLists.txt
```
# SPDX-License-Identifier: Apache-2.0

cmake_minimum_required(VERSION 3.20.0)
find_package(Zephyr REQUIRED HINTS $ENV{ZEPHYR_BASE})
project(mrf24j40_demo)

target_sources(app PRIVATE src/main.c)
```

## prj.conf
```kconfig
CONFIG_LOG=y

# Debugging for VScode
CONFIG_DEBUG_THREAD_INFO=y
CONFIG_INIT_STACKS=y
CONFIG_THREAD_STACK_INFO=y

# Demo related configuration
CONFIG_SPI=y
CONFIG_NETWORKING=y
CONFIG_IEEE802154=y
CONFIG_NET_L2_IEEE802154=y
```

## src/main.c
```c
/*
 * Copyright (c) 2016 Intel Corporation
 * Copyright (c) 2020 Nordic Semiconductor ASA
 *
 * SPDX-License-Identifier: Apache-2.0
 */

/**
 * @file Sample app to demonstrate PWM-based LED fade
 */

#include <zephyr/kernel.h>
#include <zephyr/device.h>
#include <zephyr/devicetree.h>
#include <zephyr/logging/log.h>

LOG_MODULE_REGISTER (main);

static const struct device *mrf24j40_device = DEVICE_DT_GET(DT_CHOSEN(zephyr_ieee802154));

int main(void)
{
	int ret = 0;

	LOG_INF("MRF24J40 demo start");

	if (!device_is_ready(mrf24j40_device)) {
		LOG_ERR("Error: MRF24j40 device %s is not ready",
		       mrf24j40_device->name);
		return 0;
	}

	while (1) {

		// Sleep for 2 seconds
		k_sleep(K_MSEC(2000));
	}

	return ret;
}
```
