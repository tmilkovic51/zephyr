## boards/arm/nrf52840_dongle_mrf24j40/Kconfig.board
```kconfig
config BOARD_NRF52840_DONGLE_MRF24J40
	bool "nRF52840 DONGLE MRF24J40"
	depends on SOC_NRF52840_QIAA
```

## boards/arm/nrf52840_dongle_mrf24j40/Kconfig.defconfig
```kconfig
if BOARD_NRF52840_DONGLE_MRF24J40

config BOARD
	default "nrf52840_dongle_mrf24j40"

config BT_CTLR
	default BT

endif # BOARD_NRF52840_DONGLE_MRF24J40
```

## boards/arm/ts_aqu_ccu/Kconfig.board
```kconfig
# Copyright (c) 2023 Byte Lab d.o.o. <dev@byte-lab.com>
# SPDX-License-Identifier: Apache-2.0

config BOARD_TS_AQU_CCU
	bool "TS AQU CCU board"
	depends on SOC_STM32H7A3XX
```

## boards/arm/ts_aqu_ccu/Kconfig.defconfig
```kconfig
# Copyright (c) 2023 Byte Lab d.o.o <dev@byte-lab.com>
# SPDX-License-Identifier: Apache-2.0

if BOARD_TS_AQU_CCU

config BOARD
	default "ts_aqu_ccu_board"

config SPI_STM32_INTERRUPT
	default y
	depends on SPI

endif # BOARD_TS_AQU_CCU
```

## boards/arm/ts_aqu_ccu/ts_aqu_ccu_defconfig
```kconfig
# Copyright (c) 2023 Byte Lab d.o.o. <dev@byte-lab.com>
# SPDX-License-Identifier: Apache-2.0

# Set SoC present on the board
CONFIG_SOC_SERIES_STM32H7X=y
CONFIG_SOC_STM32H7A3XX=y

# Enable MPU
CONFIG_ARM_MPU=y

# Enable HW stack protection
CONFIG_HW_STACK_PROTECTION=y

# Recommended number of kernel ticks per second for LPTIM timer clocked by 32768 kHz LSE
CONFIG_SYS_CLOCK_TICKS_PER_SEC=4096

# Enable serial
CONFIG_SERIAL=y

# Enable console
CONFIG_CONSOLE=y
CONFIG_UART_CONSOLE=y

# Enable GPIO
CONFIG_GPIO=y

# Enable clocks
CONFIG_CLOCK_CONTROL=y

# Enable pinctrl
CONFIG_PINCTRL=y
```

## drivers/ieee802154/Kconfig.mrf24j40
```kconfig
# Microchip MRF24J40 configuration options

# Copyright (c) 2022 Byte Lab d.o.o.
# SPDX-License-Identifier: Apache-2.0

menuconfig IEEE802154_MRF24J40
	bool "Microchip MRF24J40 Driver support"
	default y
	depends on DT_HAS_MICROCHIP_MRF24J40_ENABLED
	select SPI
	select GPIO

if IEEE802154_MRF24J40

config IEEE802154_MRF24J40_THREAD_STACK_SIZE
	int "Driver's internal thread stack size"
	default 800
	help
	  This option sets the driver's stack size for its internal thread.
	  The default value should be sufficient, but in case it proves to be
	  too small, it can be adjusted in this option.

config IEEE802154_MRF24J40_INIT_PRIO
	int "MRF24J40 initialization priority"
	default 80
	help
	  Set the initialization priority number. Do not mess with it unless
	  you know what you are doing. MRF24J40 requires GPIO and SPI to
	  be initialized first, and it has to initialize before the net stack.

endif
```

## drivers/sensor/aht/Kconfig
```kconfig
# AHT1x/AHT2x/AHT3x temperature and humidity sensor configuration options

# Copyright (c) 2023 Tomislav Milkovic
# SPDX-License-Identifier: Apache-2.0

menuconfig AHT
	bool "AHT1x/AHT2x/AHT3x temperature and humidity sensor"
	default y
	depends on DT_HAS_AOSONG_AHT_ENABLED
	select I2C
	select CRC
	help
	  Enable driver for AHT1x/AHT2x/AHT3x series of temperature and humidity sensors.
```

## drivers/sensor/mmc5983ma/Kconfig
```kconfig
# Copyright (c) 2022 Byte Lab d.o.o. <dev@byte-lab.com>
# SPDX-License-Identifier: Apache-2.0

menuconfig MMC5983MA
	bool "MMC5983MA magnetometer"
	depends on SPI
	help
	  Enable driver for MMC5983MA SPI-based magnetometer.

if MMC5983MA

choice MMC5983MA_TRIGGER_MODE
	prompt "Trigger mode"
	default MMC5983MA_TRIGGER_NONE
	help
	  Specify the type of triggering to be used by the driver.

config MMC5983MA_TRIGGER_NONE
	bool "No trigger"

config MMC5983MA_TRIGGER_GLOBAL_THREAD
	bool "Use global thread"
	depends on GPIO
	select MMC5983MA_TRIGGER

config MMC5983MA_TRIGGER_OWN_THREAD
	bool "Use own thread"
	depends on GPIO
	select MMC5983MA_TRIGGER

endchoice # MMC5983MA_TRIGGER_MODE

config MMC5983MA_TRIGGER
	bool

config MMC5983MA_THREAD_PRIORITY
	int "Thread priority"
	depends on MMC5983MA_TRIGGER_OWN_THREAD
	default 10
	help
	  Priority of thread used by the driver to handle interrupts.

config MMC5983MA_THREAD_STACK_SIZE
	int "Thread stack size"
	depends on MMC5983MA_TRIGGER_OWN_THREAD
	default 1024
	help
	  Stack size of thread used by the driver to handle interrupts.

choice MMC5983MA_ODR
	prompt "Output data rate"
	default MMC5983MA_ODR_50_HZ
	help
	  Magnetometer output data rate expressed in Hz.

config MMC5983MA_ODR_1_HZ
	bool "1 Hz"

	config MMC5983MA_ODR_10_HZ
	bool "10 Hz"

config MMC5983MA_ODR_20_HZ
	bool "20 Hz"

config MMC5983MA_ODR_50_HZ
	bool "50 Hz"

config MMC5983MA_ODR_100_HZ
	bool "100 Hz"

config MMC5983MA_ODR_200_HZ
	bool "200 Hz"

config MMC5983MA_ODR_1000_HZ
	bool "1000 Hz"

endchoice # MMC5983MA_ODR

choice MMC5983MA_PRD_SET
	prompt "Periodic SET frequency"
	default MMC5983MA_PRD_SET_EVERY_1000_SAMPLES
	help
	  This configuration determines how often the chip will do a SET operation.
	  The SET operation restores the sensor characteristics after it has been
	  influenced by a strong magnetic field (> 10 Gauss).
	  The SET operation will be done after every Nth measurement (N is one of options below).
	  For more info about the SET operation, consult device datasheet.

config MMC5983MA_PRD_SET_EVERY_1_SAMPLE
	bool "After every neasurement"

config MMC5983MA_PRD_SET_EVERY_25_SAMPLES
	bool "After every 25 measurements"

config MMC5983MA_PRD_SET_EVERY_75_SAMPLES
	bool "After every 75 measurements"

config MMC5983MA_PRD_SET_EVERY_100_SAMPLES
	bool "After every 100 measurements"

config MMC5983MA_PRD_SET_EVERY_250_SAMPLES
	bool "After every 250 measurements"

config MMC5983MA_PRD_SET_EVERY_500_SAMPLES
	bool "After every 500 measurements"

config MMC5983MA_PRD_SET_EVERY_1000_SAMPLES
	bool "After every 1000 measurements"

config MMC5983MA_PRD_SET_EVERY_2000_SAMPLES
	bool "After every 2000 measurements"

endchoice # MMC5983MA_PRD_SET

endif # MMC5983MA
```

## dts/bindings/ieee802154/microchip,mrf24j40.yaml
```yaml
# Copyright (c) 2022, Byte Lab d.o.o.
# SPDX-License-Identifier: Apache-2.0

description: Microchip MRF24J40 802.15.4 wireless transceiver

compatible: "microchip,mrf24j40"

include: spi-device.yaml

properties:
    int-gpios:
      type: phandle-array
      required: true
      description: Interrupt pin.

        The interrupt pin of MRF24J40. Active edge of the
        interrupt is configurable through the chip's SPI interface.
        Driver will configure the active edge according to GPIO
        flags provided in this property (GPIO_ACTIVE_LOW = falling
        edge, GPIO_ACTIVE_HIGH = rising edge).

    reset-gpios:
      type: phandle-array
      required: false
      description: RESET pin.

        The RESET pin of MRF24J40. It is active low.
        The chip has an interrnal weak pull-up resistor
        on this pin.

    wake-gpios:
      type: phandle-array
      required: false
      description: WAKE pin.

        The WAKE pin of MRF24J40. Its polarity is configurable
        through the chip's SPI interface. Driver will configure the
        polarity according to GPIO flags provided in this property
        (GPIO_ACTIVE_LOW = falling edge, GPIO_ACTIVE_HIGH = rising edge).

    mac-addr:
      type: uint8-array
      required: false
      description: Unique 64-bit MAC address assigned to device.

        This address needs to be globally unique.

    nonbeacon-mode-en:
      type: boolean
      required: false
      description: Enable IEEE 802.15.4 nonbeacon (unslotted) mode.

        If enabled, the device will support connecting to a
        nonbeacon-enabled network.
        Otherwise, the device will support beacon-enabled networks.

    turbo-mode-en:
      type: boolean
      required: false
      description: Enable high data rate - 625 kbps (turbo mode).

        The transceiver supports transmitting and receiving messages
        at 625 kbps for use with proprietary protocols.
        This data rate is not compliant with IEEE 802.15.4 standard.

    sleep-clock-32khz-en:
      type: boolean
      required: false
      description: Use external 32.768 kHz oscillator as a sleep clock.

        Enable this if external 32.768 kHz oscillator is present in hardware.
        If left disabled, then 100 kHz internal oscillator will be used as a
        sleep clock. Beware that 100 kHz internal oscillator provides inferior
        frequency accuracy and stability compared to the external 32.768 kHz
        oscillator.

    pa-lna-ctrl-en:
      type: boolean
      required: false
      description: Enable external PA/LNA switches to be controlled by MRF24J40.

        When this functionality is enabled, the internal RF state machine
        of MRF24J40 will control external PA/LNA switches via the chip's
        GPIO0, GPIO1 and GPIO2 pins.
        Enable this if you are using MRF24J40MB/MC/MD/ME module, or a custom module
        with external PA/LNA.
        If not enabled, the driver will configure GPIO0, GPIO1 and GPIO2 pins as
        inputs.

    gpio3-output:
      type: int
      required: false
      default: 0xFF
      description: Configure the chip GPIO3 as output and set it to `0` or `1`,
        depending on this property's value.

        Set this to `1` if you are using MRF24J40MC module in order to turn on
        the voltage regulator for the module's power amplifier.
        Default value of `0xFF` signals the driver to configure this pin as input.

    gpio4-output:
      type: int
      required: false
      default: 0xFF
      description: Configure the chip GPIO4 as output and set it to `0` or `1`,
        depending on this property's value.
        Default value of `0xFF` signals the driver to configure this pin as input.

    gpio5-output:
      type: int
      required: false
      default: 0xFF
      description: Configure the chip GPIO5 as output and set it to `0` or `1`,
        depending on this property's value.
        Default value of `0xFF` signals the driver to configure this pin as input.
```

## dts/bindings/mmc/st,stm32-emmc.yaml
```yaml
description: STM32 eMMC disk access

compatible: "st,stm32-emmc"

include: [mmc.yaml, pinctrl-device.yaml]

properties:
    clocks:
        required: true

    label:
        required: true

    reg:
        required: true

    pinctrl-0:
      required: true

    pinctrl-names:
      required: true

    reset-gpios:
        type: phandle-array
        required: false
        description: eMMC reset pin
```

## dts/bindings/sensor/aosong,aht.yaml
```yaml
# Copyright (c) 2023 Tomislav Milkovic
# SPDX-License-Identifier: Apache-2.0

description: |
    Aosong AHT I2C Humidity and Temperature Sensor

    The Aosong AHT family of sensors provides temperature and humidity
    measurements through digital I2C interface. Designed as a replacement
    for the DHT family, the AHT family contains an improved MEMS semiconductor
    capacitive humidity sensor and a standard on-chip temperature sensor.

    AHT1x series does not support sharing the I2C bus with other devices,
    while AHT2x and AHT3x series do.

compatible: "aosong,aht"

include: [sensor-device.yaml, i2c-device.yaml]

properties:
  power-gpios:
    type: phandle-array
    description: |
      Pin used for enabling the sensor power supply.
```

## dts/bindings/sensor/memsic,mmc5983ma.yaml
```yaml
# Copyright (c) 2022 Byte-Lab d.o.o. <dev@byte-lab.com>
# SPDX-License-Identifier: Apache-2.0

description: MMC5983MA 3-axis SPI magnetometer

compatible: "memsic,mmc5983ma"

include: spi-device.yaml

properties:
    int-gpios:
      type: phandle-array
      required: false
      description: |
        Pin on which INT output signal from
        the magnetometer is connected.
```
