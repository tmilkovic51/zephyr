## boards/others/stm32_usb_mouse/Kconfig.stm32_usb_mouse
```kconfig
# STM32 USB Mouse Configuration

config BOARD_STM32_USB_MOUSE
	select SOC_STM32F103X8
```

## boards/others/stm32_usb_mouse/board.yml
```yaml
board:
  name: stm32_usb_mouse
  full_name: STM32 USB Mouse
  vendor: others
  socs:
    - name: stm32f103xb
```

## boards/others/stm32_usb_mouse/stm32_usb_mouse_defconfig
```kconfig
# STM32 USB Mouse Configuration

# Enable uart driver
CONFIG_SERIAL=y

# Enable console
CONFIG_CONSOLE=y
CONFIG_UART_CONSOLE=y

# Enable GPIO
CONFIG_GPIO=y
```
